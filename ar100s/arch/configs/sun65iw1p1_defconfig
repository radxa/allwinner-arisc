## ar100s/driver/pmu/Kconfig
```kconfig
menuconfig PMU_USED
	bool
	prompt "PMU used"
	default y

menuconfig BMU_USED
	bool
	prompt "BMU used"
	default n

if PMU_USED

config AXP803_USED
	bool "AXP803 used"

config AXP2202_USED
	bool "AXP2202 used"

config AXP806_USED
	bool "AXP806 used"

config AXP858_USED
	bool "AXP858 used"

config AXP8191_USED
	bool "AXP8191 used"

config PMU_EXT_USED
	bool "pmu_ext used"

endif # PMU_USED

if BMU_USED

config ETA6973_USED
	bool "bmu eta6973 used"

config AXP519_USED
	bool "bmu axp519 used"

endif # BMU_USED
```
